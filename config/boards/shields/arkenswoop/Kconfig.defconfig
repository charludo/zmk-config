## config/boards/shields/arkenswoop/Kconfig.defconfig
```kconfig
# Copyright (c) 2020 The ZMK Contributors
# SPDX-License-Identifier: MIT

if SHIELD_ARKENSWOOP_LEFT

config ZMK_KEYBOARD_NAME
    default "arkenswoop2"

config ZMK_SPLIT_ROLE_CENTRAL
    default y

endif

if SHIELD_ARKENSWOOP_LEFT || SHIELD_ARKENSWOOP_RIGHT

config ZMK_SPLIT
    default y

endif
```

## config/boards/shields/arkenswoop/Kconfig.shield
```kconfig
# Copyright (c) 2020 The ZMK Contributors
# SPDX-License-Identifier: MIT

config SHIELD_ARKENSWOOP_LEFT
    def_bool $(shields_list_contains,arkenswoop_left)

config SHIELD_ARKENSWOOP_RIGHT
    def_bool $(shields_list_contains,arkenswoop_right)
```

## config/west.yml
```yaml
manifest:
  remotes:
    - name: zmkfirmware
      url-base: https://github.com/zmkfirmware
    - name: urob
      url-base: https://github.com/urob
    - name: petejohanson
      url-base: https://github.com/petejohanson
  projects:
    - name: zmk
      remote: okke-formsma
      revision: feat/pointers-move-scroll
      import: app/west.yml
  self:
    path: config
```
